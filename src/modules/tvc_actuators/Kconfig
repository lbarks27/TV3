## src/modules/tvc_actuators/Kconfig
```kconfig
menuconfig MODULES_TVC_ACTUATORS
	bool "tvc_actuators"
	default n
	---help---
		Map gimbal angles to MAIN 1-6 PWM via actuator_servos.
```

## src/modules/tvc_control/Kconfig
```kconfig
menuconfig MODULES_TVC_CONTROL
	bool "tvc_control"
	default n
	---help---
		TVC attitude control + gimbal allocation at 100 Hz (Cube Orange+).
```

## src/modules/tvc_ignition/Kconfig
```kconfig
menuconfig MODULES_TVC_IGNITION
	bool "tvc_ignition"
	default n
	---help---
		Status-only. Onboard fire GPIO is disabled; ground igniter
		starts the grains, Cube detects first motion.
```

## src/modules/tvc_log/Kconfig
```kconfig
menuconfig MODULES_TVC_LOG
	bool "tvc_log"
	default n
	---help---
		Publish flight_log_vl at 100 Hz for onboard ULog (flight_log_v1).
```

## src/modules/tvc_mission/Kconfig
```kconfig
menuconfig MODULES_TVC_MISSION
	bool "tvc_mission"
	default n
	---help---
		Solid-motor mission setpoint generator (real_landing / hover).
		Loads /fs/microsd/tvc/mission.json when packed onto the SD card.
```

## src/modules/tvc_pos_alt/Kconfig
```kconfig
menuconfig MODULES_TVC_POS_ALT
	bool "tvc_pos_alt"
	default n
	---help---
		Position and altitude outer loops (50 Hz) producing attitude/force setpoints.
```

## src/modules/tvc_safety/Kconfig
```kconfig
menuconfig MODULES_TVC_SAFETY
	bool "tvc_safety"
	default n
	---help---
		TVC arming FSM, inhibit gates, commander arm request (pattern A).
```

## src/modules/tvc_thrust/Kconfig
```kconfig
menuconfig MODULES_TVC_THRUST
	bool "tvc_thrust"
	default n
	---help---
		Motor curve thrust publisher for 3 mounts (SD CSV + trapezoid).
```
